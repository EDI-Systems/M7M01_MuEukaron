## Project/ECLIPSE-GCC-XC7Z020/RME/RME.its
```
/*
 * Simple U-Boot uImage source file containing a single kernel
 */

/dts-v1/;

/ {
	description = "Simple image with single RME kernel";
	#address-cells = <1>;

	images {
		kernel {
			description = "Vanilla RME kernel";
			data = /incbin/("./Debug/RME.bin");
			type = "kernel";
			arch = "arm";
			os = "RME";
			compression = "none";
			load = <0x10000000>;
			entry = <0x10000000>;
			hash-1 {
				algo = "crc32";
			};
			hash-2 {
				algo = "sha1";
			};
		};
	};

	configurations {
		default = "config-1";
		config-1 {
			description = "Boot RME kernel";
			kernel = "kernel";
		};
	};
};
```
